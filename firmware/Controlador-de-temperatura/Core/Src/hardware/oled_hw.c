#include "hardware/oled_hw.h"
#include "hardware/i2c_hw.h"
#include "main.h"
#include <string.h>
#include <stdio.h>

extern I2C_HandleTypeDef hi2c1;

#define OLED_WIDTH 128
#define OLED_HEIGHT 64
#define OLED_PAGES (OLED_HEIGHT / 8)
#define OLED_BUFFER_SIZE (OLED_WIDTH * OLED_PAGES)
#define OLED_REAL_WIDTH 132 // SH1106 has 132 column RAM

static uint8_t oled_buffer[OLED_BUFFER_SIZE];
static uint8_t i2c_tx_buf[OLED_REAL_WIDTH + 1]; // Need 132 + control byte

// static uint8_t oled_ram_frame[OLED_REAL_WIDTH * OLED_PAGES]; // Real frame buffer for SH1106

static void oled_send_cmd(uint8_t cmd)
{
    i2c_tx_buf[0] = 0x00;
    i2c_tx_buf[1] = cmd;
    HAL_I2C_Master_Transmit(&hi2c1, OLED_I2C_ADDRESS, i2c_tx_buf, 2, 100);
}

static void oled_send_data_buffer(uint8_t *data, uint16_t len)
{
    i2c_tx_buf[0] = 0x40;
    memcpy(&i2c_tx_buf[1], data, len);
    HAL_I2C_Master_Transmit(&hi2c1, OLED_I2C_ADDRESS, i2c_tx_buf, len + 1, 100);
}

void oled_hw_init(void)
{
    HAL_Delay(100);

    oled_send_cmd(0xAE);
    oled_send_cmd(0xD5);
    oled_send_cmd(0x80);
    oled_send_cmd(0xA8);
    oled_send_cmd(0x3F);
    oled_send_cmd(0xD3);
    oled_send_cmd(0x00);
    oled_send_cmd(0x40);
    oled_send_cmd(0x8D);
    oled_send_cmd(0x14);
    oled_send_cmd(0xAD);
    oled_send_cmd(0x8B);
    oled_send_cmd(0xA1);
    oled_send_cmd(0xC8);
    oled_send_cmd(0xDA);
    oled_send_cmd(0x12);
    oled_send_cmd(0x81);
    oled_send_cmd(0x7F);
    oled_send_cmd(0x20);
    oled_send_cmd(0x00);
    oled_send_cmd(0xA4);
    oled_send_cmd(0xA6);
    oled_send_cmd(0xAF);

    oled_hw_clear();
    oled_hw_update();
}

void oled_hw_clear(void)
{
    memset(oled_buffer, 0, OLED_BUFFER_SIZE);
}

void oled_hw_update(void)
{
    for (uint8_t page = 0; page < OLED_PAGES; page++)
    {
        oled_send_cmd(0xB0 | page);
        oled_send_cmd(0x02); // low column = 2 (SH1106 offset)
        oled_send_cmd(0x10); // high column = 0
        oled_send_data_buffer(&oled_buffer[page * OLED_WIDTH], OLED_WIDTH);
    }
}

void oled_hw_test_pattern(void)
{
    oled_hw_clear();
    for (int i = 0; i < OLED_BUFFER_SIZE; i++)
    {
        oled_buffer[i] = 0xFF * (i % 2);
    }
    oled_hw_update();
}

static const uint8_t ssd1306xled_font6x8[] = {
    0x00, 0x00, 0x00, 0x00, 0x00, 0x00, // sp
    0x00, 0x00, 0x00, 0x2f, 0x00, 0x00, // !
    0x00, 0x00, 0x07, 0x00, 0x07, 0x00, // "
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    0x00, 0x14, 0x14, 0x14, 0x14, 0x14  // horiz lines
};

static void oled_draw_char(uint8_t c, uint8_t x, uint8_t page)
{
    if (c < 32 || c > 122)
        return;
    c -= 32;

    for (int col = 0; col < 6; col++)
    {
        if (x + col < OLED_WIDTH)
        {
            oled_buffer[page * OLED_WIDTH + x + col] = ssd1306xled_font6x8[c * 6 + col];
        }
    }
}

void oled_hw_print_str(const char *str, uint8_t page)
{
    for (int i = 0; str[i] != '\0'; i++)
    {
        oled_draw_char(str[i], i * 6, page);
    }
}

void oled_hw_print_str_at(const char *str, uint8_t page, uint8_t offset)
{
    for (int i = 0; str[i] != '\0'; i++)
    {
        oled_draw_char(str[i], offset + i * 6, page);
    }
}

void oled_hw_print_num(int num, uint8_t page)
{
    char buf[12];
    snprintf(buf, sizeof(buf), "%d", num);

    for (int i = 0; buf[i] != '\0'; i++)
    {
        oled_draw_char(buf[i], i * 6, page);
    }
}

void oled_hw_print_float(float val, uint8_t page)
{
    char buf[12];

    int int_part = (int)val;
    int dec_part = (int)((val - (float)int_part) * 100.0f);

    if (dec_part < 0)
        dec_part = -dec_part;

    snprintf(buf, sizeof(buf), "%d.%02d", int_part, dec_part);

    for (int i = 0; buf[i] != '\0'; i++)
    {
        oled_draw_char(buf[i], i * 6, page);
    }
}

void oled_hw_print_float_at(float val, uint8_t page, uint8_t x_offset)
{
    char buf[12];

    int int_part = (int)val;
    int dec_part = (int)((val - (float)int_part) * 100.0f);

    if (dec_part < 0)
        dec_part = -dec_part;

    snprintf(buf, sizeof(buf), "%d.%02d", int_part, dec_part);

    for (int i = 0; buf[i] != '\0'; i++)
    {
        oled_draw_char(buf[i], x_offset + i * 6, page);
    }
}

void oled_draw_char_at(uint8_t c, uint8_t x, uint8_t page){
    oled_draw_char(c, x, page);
}